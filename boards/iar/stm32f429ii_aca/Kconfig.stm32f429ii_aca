## boards/iar/stm32f429ii_aca/Kconfig.stm32f429ii_aca
```kconfig
# Copyright (c) 2016 Linaro Limited.
# SPDX-License-Identifier: Apache-2.0

config BOARD_STM32F429II_ACA
	select SOC_STM32F429XX
```

## boards/iar/stm32f429ii_aca/board.yml
```yaml
board:
  name: stm32f429ii_aca
  full_name: STM32F429II-ACA
  vendor: IAR
  socs:
    - name: stm32f429xx
```
